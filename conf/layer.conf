## conf/layer.conf
```bitbake
# We have a conf and classes directory, add to BBPATH
BBPATH .= ":${LAYERDIR}"

# We have recipes-* directories, add to BBFILES
BBFILES += "${LAYERDIR}/recipes-*/*/*.bb \
            ${LAYERDIR}/recipes-*/*/*.bbappend"

BBFILE_COLLECTIONS += "meta-gpsTracker"
BBFILE_PATTERN_meta-gpsTracker = "^${LAYERDIR}/"
BBFILE_PRIORITY_meta-gpsTracker = "6"

LAYERDEPENDS_meta-gpsTracker = "core"
LAYERSERIES_COMPAT_meta-gpsTracker = "warrior"
```
